## Kconfig
```kconfig
menuconfig PAW3222
    bool "PAW3222 mouse optical sensor"
  select SPI
    help
      Enable PAW3222 mouse optical sensor.

config PAW3222_SCROLL_ACCEL
    bool "Enable scroll acceleration"
    default y
    help
      Enable acceleration for scrolling based on movement speed.

config PAW3222_SCROLL_ACCEL_SENSITIVITY
    int "Scroll acceleration sensitivity (1-10)"
    default 3
    range 1 10
    depends on PAW3222_SCROLL_ACCEL
    help
      Higher values make scrolling more responsive with stronger acceleration.

config PAW3222_SCROLL_TICK
    int "Required ticks to produce a scroll report"
    default 20
    help
      Scroll tick value. Higher values require more movement to trigger a scroll event.

config PAW3222_INVERT_SCROLL_X
    bool "Invert the X axis of the scroll"

config PAW3222_INVERT_SCROLL_Y
    bool "Invert the Y axis of the scroll"
```
